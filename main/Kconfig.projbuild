## main/Kconfig.projbuild
```kconfig
menu "HW Version Selection"

    choice
        prompt "Select TRC_WIFI_A Hardware Version"
        default HW_VERSION_A_1

        config HW_VERSION_A_1
            bool "TowelRack-Controller-WiFi-A1"
        config HW_VERSION_A_2
            bool "TowelRack-Controller-WiFi-A2"
    endchoice

endmenu

menu "Network Configuration"

    config SET_MAC_ADDRESS_OF_TARGET_AP
        bool "whether set MAC address of target AP or not"
        default n

endmenu
```
